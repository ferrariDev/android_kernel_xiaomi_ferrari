## arch/arm64/hotplug/Kconfig
```kconfig
config THUNDERPLUG_CONTROL
	bool "Enable plugging down/up of cores using powersuspend"
	help
	  This driver uses powersuspend to take down the cpu cores
	  on a octa core device.

config MSM_HOTPLUG
	bool "MSM hotplug driver"
	depends on HOTPLUG_CPU
	default y
	help
	  The MSM hotplug driver controls on-/offlining of additional cores based
	  on current cpu load.
```
